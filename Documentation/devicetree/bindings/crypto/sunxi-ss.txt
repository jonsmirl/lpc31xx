## Documentation/devicetree/bindings/crypto/sunxi-ss.txt
```
* Allwinner Security System found on A20 SoC

Required properties:
- compatible : Should be "allwinner,sun7i-a20-crypto".
- reg: Should contain the Security System register location and length.
- interrupts: Should contain the IRQ line for the Security System.
- clocks : A phandle to the functional clock node of the Security System module
- clock-names : Name of the functional clock, should be "ahb" and "mod".
```

## Documentation/devicetree/bindings/net/wireless/brcm,bcm43xx-fmac.txt
```
Broadcom BCM43xx Fullmac wireless SDIO devices

This node provides properties for controlling the Broadcom wireless device. The
node is expected to be specified as a child node to the SDIO controller that
connects the device to the system.

Required properties:

 - compatible : Should be "brcm,bcm43xx-fmac".

Optional properties:
 - brcm,drive-strength : drive strength used for SDIO pins on device.
	(default = 6mA).
 - interrupt-parent : the phandle for the interrupt controller to which the
	device interrupts are connected.
 - interrupts : specifies attributes for the out-of-band interrupt (host-wake).
	When not specified the device will use in-band SDIO interrupts.
 - interrupt-names : name of the out-of-band interrupt, which must be set
	to "host-wake".

Example:

bcm4335 {
	compatible = "brcm,bcm43xx-fmac";
	brcm,drive-strength = <4>;
	interrupt-parent = <&gpx2>;
	interrupts = <5 IRQ_TYPE_LEVEL_HIGH>;
	interrupt-names = "host-wake";
};
```

## arch/arm/configs/sunxi_full_defconfig
```kconfig
CONFIG_SYSVIPC=y
CONFIG_BSD_PROCESS_ACCT=y
CONFIG_IKCONFIG=y
CONFIG_IKCONFIG_PROC=y
CONFIG_BLK_DEV_INITRD=y
CONFIG_INITRAMFS_SOURCE="/home/emilio/buildroot/output/images/rootfs.cpio"
CONFIG_RD_LZO=y
CONFIG_INITRAMFS_COMPRESSION_LZO=y
CONFIG_EMBEDDED=y
CONFIG_JUMP_LABEL=y
CONFIG_PARTITION_ADVANCED=y
CONFIG_ARCH_SUNXI=y
# CONFIG_SWP_EMULATE is not set
CONFIG_SMP=y
CONFIG_AEABI=y
CONFIG_HIGHMEM=y
CONFIG_CPU_FREQ=y
CONFIG_CPU_FREQ_DEFAULT_GOV_ONDEMAND=y
CONFIG_VFP=y
CONFIG_NEON=y
CONFIG_NET=y
CONFIG_PACKET=y
CONFIG_INET=y
CONFIG_DEVTMPFS=y
CONFIG_EEPROM_AT24=y
CONFIG_EEPROM_SUNXI_SID=y
CONFIG_ATA=y
CONFIG_AHCI_SUNXI=y
CONFIG_NETDEVICES=y
CONFIG_SUN4I_EMAC=y
CONFIG_STMMAC_ETH=y
# CONFIG_WLAN is not set
CONFIG_SERIAL_8250=y
CONFIG_SERIAL_8250_CONSOLE=y
CONFIG_SERIAL_8250_NR_UARTS=8
CONFIG_SERIAL_8250_RUNTIME_UARTS=8
CONFIG_SERIAL_8250_DW=y
CONFIG_I2C=y
CONFIG_I2C_CHARDEV=y
CONFIG_I2C_MV64XXX=y
CONFIG_SPI=y
CONFIG_SPI_SUN4I=y
CONFIG_SPI_SUN6I=y
CONFIG_WATCHDOG=y
CONFIG_SUNXI_WATCHDOG=y
CONFIG_USB=y
CONFIG_USB_EHCI_HCD=y
CONFIG_USB_EHCI_HCD_PLATFORM=y
CONFIG_USB_OHCI_HCD=y
CONFIG_USB_OHCI_HCD_PLATFORM=y
CONFIG_USB_STORAGE=y
CONFIG_NEW_LEDS=y
CONFIG_LEDS_CLASS=y
CONFIG_LEDS_GPIO=y
CONFIG_LEDS_TRIGGERS=y
CONFIG_LEDS_TRIGGER_HEARTBEAT=y
CONFIG_RTC_CLASS=y
CONFIG_RTC_DRV_SUNXI=y
CONFIG_PHY_SUN4I_USB=y
CONFIG_DEBUG_FS=y
CONFIG_DEBUG_LL=y
CONFIG_EARLY_PRINTK=y
```

## sound/soc/sunxi/Kconfig
```kconfig
menu "SoC Audio support for Allwinner SoCs"
        depends on ARCH_SUNXI

config SND_SUNXI_SOC_CODEC
	tristate "APB on-chip sun4i/sun5i/sun7i CODEC"
	select SND_SOC_GENERIC_DMAENGINE_PCM
	select REGMAP_MMIO
	default y

config SND_SUNXI_SOC_I2S
	tristate "sun4i/sun5i/sun7i I2S"
	select SND_SOC_GENERIC_DMAENGINE_PCM
	select REGMAP_MMIO
	default y

endmenu
```
